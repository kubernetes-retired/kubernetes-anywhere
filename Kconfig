## Kconfig
```kconfig
mainmenu "Kubernetes Minimal Turnup Configuration"

source "phase1/Kconfig"
source "phase2/Kconfig"
source "phase3/Kconfig"
```

## phase1/Kconfig
```kconfig
menu "Phase 1: Cluster Resource Provisioning"

config phase1.num_nodes
	int "number of nodes"
	default 3
	range 1 1000
	help
	  The number of nodes you would like to provision.

config phase1.cluster_name
	string "kubernetes cluster name"
	default "kubernetes"
	help
	  An identifier to use for this cluster.
	  This is used for compute instance names as a prefix,
	  and for naming any other cloud provider resources.

config phase1.ssh_user
	string "SSH user to login to OS for provisioning"
	default ""
	help
	  The username with which to login to the target OS via ssh.
	  This is optional, and is meant to override the default
	  behavior of using the current user's name.

menuconfig phase1.cloud_provider
	string "cloud provider: gce, vsphere or openstack"
	default "gce"
	help
	  The cloud provider you would like to deploy to.

if phase1.cloud_provider = "gce"
	source "phase1/gce/Kconfig"
endif

if phase1.cloud_provider = "vsphere"
	source "phase1/vsphere/Kconfig"
endif

if phase1.cloud_provider = "openstack"
	source "phase1/openstack/Kconfig"
endif

endmenu
```

## phase1/azure/Kconfig
```kconfig
menu "Azure configuration"

config phase1.azure.subscription_id
	string "Azure SubscriptionID"
	help
		The Azure Subscription ID

config phase1.azure.client_id
	string "Azure Active Directory ServicePrincipal ClientID"
	help
		The ClientID of the Service Account to be used by the cluster components. (If left blank, will be created automatically)

config phase1.azure.client_secret
	string "Azure Active Directory ServicePrincipal ClientSecret"
	help
		The ClientSecret of the Service Account to be used by the cluster components. (If left blank, will be created automatically)

config phase1.azure.image_publisher
	string "Base Virtual Machine OS Image"
	default "canonical"
	help
		The publisher of the base image used for the VirtualMachines.
config phase1.azure.image_offer
	string "Base Virtual Machine OS Image"
	default "ubuntuserver"
	help
		The offer of the base image used for the VirtualMachines.
config phase1.azure.image_sku
	string "Base Virtual Machine OS Image"
	default "16.04.0-LTS"
	help
		The sku of the base image used for the VirtualMachines.

config phase1.azure.image_version
	string "Base Virtual Machine OS Image"
	default "latest"
	help
		The version of the base image used for the VirtualMachines.

config phase1.azure.storage_account_name
	string "Azure Storage Account Name"
	help
		The name of the storage account to store VHDs in. (If left blank, a random name will be generated)

config phase1.azure.master_vm_size
	string "Virtual Machine Size (Master)"
	default "Standard_D1_v2"
	help
		The size of VirtualMachine to deploy.

config phase1.azure.node_vm_size
	string "Virtual Machine Size (Node)"
	default "Standard_D1_v2"
	help
		The size of VirtualMachine to deploy.

config phase1.azure.master_private_ip
	string "Private IP address of Master"
	default "10.240.1.4"
	help
		The private ip address of master

config phase1.azure.location
	string "Resource Location"
	default "westus2"
	help
		The Azure location to use.

config phase1.azure.admin_username
	string "Virtual Machine Admin Username"
	default "kube"

config phase1.azure.admin_password
	string "Virtual Machine Admin Password"
	default "Ch@ng3ThisPassword"

endmenu
```

## phase1/openstack/Kconfig
```kconfig
menu "Openstack configuration"

config phase1.openstack.os_image
	string "OS image for nodes"
	help
	  The image name used for deploying a VM.

config phase1.openstack.flavor_name
	string "flavor name"
	default "m1.medium"
	help
	  The flavor name to use for the VM instance.

config phase1.openstack.ssh_key_file
	string "path to ssh private key file"
	default "~/.ssh/id_rsa.terraform"
	help
	  The path to ssh private key file with which to configure
	  the vm for auto-login. The public key file should also
	  exist at the same path prefixed by .pub.

config phase1.openstack.project_name
	string "OpenStack project name"
	help
	  The OpenStack project name in which to deploy VMs.

config phase1.openstack.domain_name
	string "OpenStack domain name"
	help
	  The OpenStack domain name in which to deploy VMs.

config phase1.openstack.auth_url
	string "auth_url"
	help
	  The OpenStack keystone URL used for authentication.

config phase1.openstack.username
	string "OpenStack Keystone username"
	help
	  The OpenStack Keystone username used for authentication.

config phase1.openstack.password
	string "OpenStack Keystone password"
	help
	  The OpenStack Keystone password used for authentication.

config phase1.openstack.network_name
	string "Name of internal Neutron network"
	help
	  Name of the private Neutron network that would be created and VMs assigned to it.

config phase1.openstack.network_cidr
	string "CIDR of internal Neutron network"
	help
	  CIDR of the private Neutron network that would be created.

config phase1.openstack.floatingip_pool_name
	string "Name of external pool network"
	help
	  Name of the floating ip pool to use.
	  You can retrieve this by running: `openstack ip floating pool list`

config phase1.openstack.external_gateway
	string "Network UUID of External Gateway"
	help
	  The network UUID of an external gateway for the router
	  You can retrieve this by running: `openstack network show <external-network>`
	  and picking the value against `id`.

endmenu
```

## phase1/vsphere/Kconfig
~~~~kconfig
menu "vSphere configuration"

config phase1.vSphere.url
	string "vCenter URL Ex: 10.192.10.30 or myvcenter.io (without https://)"
	help
		The vCenter Url

config phase1.vSphere.port
	int "vCenter port"
	default 443
	help
		The vCenter port

config phase1.vSphere.username
	string "vCenter username"
	help
		The vCenter Username

config phase1.vSphere.password
	string "vCenter password"
	help
		The vCenter password

config phase1.vSphere.insecure
	bool "Does host use self-signed cert"
	default y
	help
		If the host uses a self-signed cert.

config phase1.vSphere.datacenter
	string "Datacenter"
	default "datacenter"
	help
		The datacenter to be used by vSphere cloud provider plugin. Use vCenter UI or ```govc datacenter.info```

config phase1.vSphere.datastore
	string "Datastore"
	default "datastore"
	help
		The datastore where VMs will be created. This will also be used for provisioning volumes for storage classes.

config phase1.vSphere.placement
	string "Deploy Kubernetes Cluster on 'host' or 'cluster'"
	default "cluster"
	help
		Select Where to deploy Kubernetes Cluster. On specific host or cluster

if phase1.vSphere.placement = "host"
	config phase1.vSphere.host
        string "host"
        default ""
        help
			Host where kubernetes cluster will be created.
endif

if phase1.vSphere.placement = "cluster"
	config phase1.vSphere.cluster
        string "vsphere cluster name. Please make sure that all the hosts in the cluster are time-synchronized otherwise some of the nodes can remain in pending state for ever due to expired certificate"
        default ""
        help
			vSphere cluster where kubernetes cluster will be created.
endif

config phase1.vSphere.useresourcepool
	string "Do you want to use the existing resource pool on the host or cluster? [yes, no]"
	default "no"
	help
		Deploy cluster on existing Resource Pool? Enter yes or no

if phase1.vSphere.useresourcepool = "yes"
	config phase1.vSphere.resourcepool
        string "Name of the existing Resource Pool. If Resource pool is enclosed within another Resource pool, specify pool hierarchy as ParentResourcePool/ChildResourcePool"
        default ""
        help
			Existing Resource Pool where kubernetes cluster will be deployed.
endif

config phase1.vSphere.vmfolderpath
	string "VM Folder name or Path (e.g kubernetes, VMFolder1/dev-cluster, VMFolder1/Test Group1/test-cluster). Folder path will be created if not present"
	default "kubernetes"
	help
		VM Folder Path where Node VMs should be placed.

config phase1.vSphere.vcpu
	int "Number of vCPUs for each VM"
	default 1
	help
		Number of vcpu required for VM.

config phase1.vSphere.memory
	int "Memory for VM"
	default 2048
	help
		Memory required for each VM.

config phase1.vSphere.network
	string "Network for VM"
	default "VM Network"
	help
		Network to use for each VM.

config phase1.vSphere.template
	string "Name of the template VM imported from OVA. If Template file is not available at the destination location specify vm path"
	default "KubernetesAnywhereTemplatePhotonOS.ova"
	help
		Template to clone VMs from.

config phase1.vSphere.flannel_net
	string "Flannel Network"
	default "172.1.0.0/16"
	help
		 IP range used for flannel overlay network.

endmenu
~~~~

## phase2/Kconfig
```kconfig
menu "Phase 2: Node Bootstrapping"

config phase2.kubernetes_version
	string "kubernetes version"
	default "v1.8.4"
	help
	  The version of Kubernetes to deploy to the control plane.

config phase2.docker_registry
	string "docker registry"
	default "gcr.io/google-containers"
	help
	  The docker registry to pull cluster components from.

config phase2.provider
	string "bootstrap provider"
	default "kubeadm" if phase1.cloud_provider = "gce" || phase1.cloud_provider = "openstack"
	default "ignition"
	help
	  The bootstrap provider to use.

	  Valid options are (ignition, kubeadm).

config phase2.proxy_mode
	string "kube-proxy mode: iptables or ipvs"
	default "iptables"
	help
	  The kube-proxy mode to use.

	  Valid options are (iptables, ipvs).

if phase2.provider = ignition

config phase2.installer_container
	string "installer container"
	default "docker.io/cnastorage/k8s-ignition:v2"

endif

if phase2.provider = kubeadm

config phase2.kubeadm.version
	string "kubeadm version"
	default "stable"
	help
	  The version of kubeadm to use.

	  Valid options are "stable" or a Google Cloud Storage link to a build.

config phase2.kubelet_version
	string "kubelet version"
	default "stable"
	help
	  The version of kubelet to use.

	  Valid options are "stable" or a Google Cloud Storage link to a build.

config phase2.kubeadm.master_upgrade.method
	string "kubeadm master upgrade method"
	default "upgrade"
	help
	  The kubeadm method of master upgrade to use.

	  Valid options are (upgrade,init).
	  Formally supported options are (upgrade).

config phase2.kube_context_name
    string "kube context name"
    default phase1.cluster_name
    help
	  The name of the context in kubeconfig.
	  This is optional to set and when set, the kubeconfig
	  context is renamed to whatever is configured.

config phase2.enable_cloud_provider
	bool "Enable Cloud Provider(Experimental) ?"
	default n
	help
	  Should we enable and initialize cloud provider for the cluster?

config phase2.kubeadm.feature_gates
	string "kubeadm feature gates"
	default ""
	help
	  Enable or disable specific features of kubeadm.

	  Valid options are a set of key-value pairs in format : "<key-1>=<values-1>,<key-2>=<value-2>,.."
	  as of today values must be booleans : true or false
	  see "--feature-gates" option of kubeadm for description of keys.

endif

endmenu
```

## phase3/Kconfig
```kconfig
menu "Phase 3: Deploying Addons"

config phase3.run_addons
	bool "Run the addon manager?"
	default y
	help
	  Should we deploy the addon manager?

if phase3.run_addons && phase2.provider != kubeadm

config phase3.kube_proxy
	bool "Run kube-proxy?"
	default y
	help
	  Should we deploy the kube-proxy to nodes?

config phase3.kube_dns
	bool "Run kube-dns?"
	default y
	help
	  Should we deploy kube-dns?

endif 

if phase3.run_addons 

config phase3.dashboard
	bool "Run the dashboard?"
	default y
	help
	  Should we deploy the kubernetes dashboard?

config phase3.heapster
	bool "Run heapster?"
	default y
	help
	  Should we deploy heapster?

config phase3.weave_net
	bool "Run weave-net?"
	default n
	help
	  [Deprecated] Please use phase3.cni instead.

		Should we deploy weave-net? You likely only want this if using kubeadm for phase2.

if phase3.weave_net = n
config phase3.cni
	string "CNI plugin to use"
	default ""
	help
	  CNI plugin to use. You likely only want this if using kubeadm for phase2.
          Valid options are (calico, flannel, weave).
endif

if phase1.cloud_provider = gce
config phase3.gce_storage_class
	depends on phase2.enable_cloud_provider
	bool "Deploy default storage class?"
	default n
	help
	  Should we deploy default storage class for GCE?
endif

endif

endmenu
```
